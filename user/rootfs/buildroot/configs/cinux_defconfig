## user/rootfs/buildroot/configs/cinux_defconfig
```kconfig
BR2_x86_64=y
BR2_TOOLCHAIN_EXTERNAL=y
BR2_TOOLCHAIN_EXTERNAL_BOOTLIN=y
BR2_TOOLCHAIN_EXTERNAL_BOOTLIN_X86_64_GLIBC_STABLE=y
BR2_INIT_BUSYBOX=y
BR2_SYSTEM_BIN_SH_BUSYBOX=y
BR2_ROOTFS_DEVICE_CREATION_STATIC=y
# BR2_ROOTFS_MERGED_USR is not set
# BR2_TARGET_GENERIC_GETTY is not set
# BR2_TARGET_GENERIC_REMOUNT_ROOTFS_RW is not set
BR2_SYSTEM_DHCP=""
BR2_TARGET_GENERIC_HOSTNAME="cinux"
BR2_TARGET_GENERIC_ISSUE="Cinux development environment"
BR2_PACKAGE_BUSYBOX=y
BR2_TARGET_ROOTFS_TAR=y
# BR2_TARGET_ROOTFS_EXT2 is not set
# BR2_LINUX_KERNEL is not set
BR2_PACKAGE_BUSYBOX_CONFIG="@CINUX_BUSYBOX_CONFIG@"
BR2_ROOTFS_OVERLAY="@CINUX_NATIVE_OVERLAY@"
BR2_ROOTFS_USERS_TABLES="@CINUX_USERS_TABLE@"
```
